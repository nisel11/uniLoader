## configs/fleur_defconfig
```kconfig
CONFIG_COMPRESS_GZIP=y
CONFIG_UART_DEBUG=n
CONFIG_SIMPLE_FB=y
CONFIG_MT6781=y
CONFIG_XIAOMI_FLEUR=y
CONFIG_TEXT_BASE=0x40080000
CONFIG_RAMDISK_ENTRY=0x47c80000
CONFIG_PAYLOAD_ENTRY=0x50000000
```

## configs/manaus_defconfig
```kconfig
CONFIG_COMPRESS_GZIP=y
CONFIG_UART_DEBUG=n
CONFIG_SIMPLE_FB=y
CONFIG_MT6879=y
CONFIG_MOTOROLA_MANAUS=y
CONFIG_TEXT_BASE=0x40000000
CONFIG_RAMDISK_ENTRY=0x66f00000
CONFIG_PAYLOAD_ENTRY=0x50000000
```
